## sysutils/u-boot-sinovoip-bpi-m3/files/patch-configs_Sinovoip__BPI__M3__defconfig
```kconfig
--- configs/Sinovoip_BPI_M3_defconfig.orig	2016-04-12 02:22:25 UTC
+++ configs/Sinovoip_BPI_M3_defconfig
@@ -5,6 +5,11 @@ CONFIG_DRAM_TYPE=7
 CONFIG_DRAM_CLK=480
 CONFIG_DRAM_ZQ=15355
 CONFIG_DRAM_ODT_EN=y
+CONFIG_MMC0_CD_PIN="PF6"
+CONFIG_USB0_VBUS_PIN="AXP0-VBUS-ENABLE"
+CONFIG_USB0_VBUS_DET="AXP0-VBUS-DETECT"
+CONFIG_USB0_ID_DET="PH11"
+CONFIG_USB1_VBUS_PIN="PD24"
 CONFIG_AXP_GPIO=y
 CONFIG_DEFAULT_DEVICE_TREE="sun8i-a83t-sinovoip-bpi-m3"
 # CONFIG_SYS_MALLOC_CLEAR_ON_INIT is not set
@@ -12,5 +17,14 @@ CONFIG_SPL=y
 # CONFIG_CMD_IMLS is not set
 # CONFIG_CMD_FLASH is not set
 # CONFIG_CMD_FPGA is not set
-CONFIG_AXP_DCDC1_VOLT=3000
+CONFIG_CMD_GPIO=y
+CONFIG_AXP_DCDC1_VOLT=3300
 CONFIG_AXP_DCDC5_VOLT=1200
+CONFIG_AXP_DLDO3_VOLT=2500
+CONFIG_AXP_DC1SW_EN=1
+CONFIG_USB_EHCI_HCD=y
+CONFIG_USB_MUSB_HOST=y
+
+# SATA port
+#CONFIG_INITIAL_USB_SCAN_DELAY=500
+#CONFIG_SYS_EXTRA_OPTIONS="SATAPWR=SUNXI_GPD(25)"
```
